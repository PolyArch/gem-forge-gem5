## src/mem/ruby/protocol/stream/Kconfig
```kconfig
config RUBY_PROTOCOL_MESI_Three_Level_Stream
    bool "MESI three level stream"
    default n

config RUBY_PROTOCOL_MESI_Two_Level_Stream
    bool "MESI two level stream"
    default n
```
